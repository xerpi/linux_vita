// SPDX-License-Identifier: GPL-2.0
/*
 * Device Tree Source for the PlayStation TV
 */

/dts-v1/;

#include <dt-bindings/interrupt-controller/arm-gic.h>
#include "vita.dtsi"

/ {
	chosen {
		bootargs = "earlyprintk console=tty0 console=ttyS0";

		framebuffer0: framebuffer@20000000 {
			compatible = "simple-framebuffer";
			reg = <0x20000000 (1280*720*4)>;
			width = <1280>;
			height = <720>;
			stride = <(1280*4)>;
			format = "a8b8g8r8";
			status = "okay";
		};
	};
};
